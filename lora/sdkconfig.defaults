## lora/sdkconfig.defaults
```kconfig
CONFIG_LV_FONT_MONTSERRAT_12=y
CONFIG_LV_FONT_MONTSERRAT_24=y
CONFIG_MISO_GPIO=7
CONFIG_SCK_GPIO=5
CONFIG_MOSI_GPIO=6
CONFIG_CS_GPIO=4
CONFIG_RST_GPIO=15
CONFIG_ESP_CONSOLE_USB_SERIAL_JTAG=y
CONFIG_ESP_CONSOLE_SECONDARY_NONE=y
# CONFIG_SPIRAM is not set
```
